## bsp/k210/applications/Kconfig
```kconfig
menu "User Application"

menuconfig USING_EPAPER
    bool    "Using Epaper"
    default n

if USING_EPAPER
    choice 
        prompt "墨水屏在SPI1上的片选"
        config EPAPER_USE_SS0
            bool "片选0(SS0)"
            select BSP_SPI1_USING_SS0
        config EPAPER_USE_SS1
            bool "片选1(SS1)"
            select BSP_SPI1_USING_SS1
        config EPAPER_USE_SS2
            bool"片选2(SS2)"
            select BSP_SPI1_USING_SS2
        config EPAPER_USE_SS3
            bool"片选3(SS3)"
            select BSP_SPI1_USING_SS3
    endchoice

    menuconfig EPAPER_DC_PIN
        int "墨水屏数据/命令控制引脚"
    default 11

    menuconfig EPAPER_X_MAX
        int "墨水屏x轴分辨率"
        default 200
    menuconfig EPAPER_Y_MAX
        int "墨水屏y轴分辨率"
        default 200
    

endif
endmenu
```

## bsp/k210/driver/Kconfig
```kconfig
menu "WaveShare"

menuconfig USING_EPAPER
    bool    "Using Epaper"
    default n

if USING_EPAPER
    choice 
        prompt "墨水屏型号"
        config EPAPER_1IN54
            bool "1.54英寸(黑白)"
        config EPAPER_1IN54_B
            bool "1.54英寸(黑白红)"
        config EPAPER_1IN54_C
            bool "1.54英寸(黑白黄)"

        config EPAPER_2IN13
            bool "2.13英寸(黑白)"
        config EPAPER_2IN13_B
            bool "2.13英寸(黑白红)"
        config EPAPER_2IN13_C
            bool "2.13英寸(黑白黄)"

        config EPAPER_2IN7
            bool "2.7英寸(黑白)"
        config EPAPER_2IN7_B
            bool "2.7英寸(黑白红)"
        config EPAPER_2IN7_C
            bool "2.7英寸(黑白黄)"

        config EPAPER_2IN9
            bool "2.9英寸(黑白)"
        config EPAPER_2IN9_B
            bool "2.94英寸(黑白红)"
        config EPAPER_2IN9_C
            bool "2.9英寸(黑白黄)"
        
        config EPAPER_4IN2
            bool "4.2英寸(黑白)"
        config EPAPER_4IN2_B
            bool "4.2英寸(黑白红)"
        config EPAPER_4IN2_C
            bool "4.2英寸(黑白黄)"

        config EPAPER_5IN83
            bool "5.83英寸(黑白)"
        config EPAPER_5IN83_B
            bool "5.83英寸(黑白红)"
        config EPAPER_5IN83_C
            bool "5.83英寸(黑白黄)"

        config EPAPER_6IN0
            bool "6英寸(黑白)"
        config EPAPER_6IN0_HD
            bool "6英寸(高清)"
        config EPAPER_6IN0_HD_TOUCH
            bool "6英寸(高清+触摸)"
        
        config EPAPER_7IN5
            bool "7.5英寸(黑白)"
        config EPAPER_7IN5_B
            bool "7.5英寸(黑白红)"
        config EPAPER_7IN5_C
            bool "7.5英寸(黑白黄)"

        config EPAPER_7IN8
            bool "7.8英寸"
        config EPAPER_9IN7
            bool "9.7英寸"
        config EPAPER_10IN3_D
            bool "10.3英寸"

        default EPAPER_1IN54
    endchoice

    choice 
        prompt "墨水屏在SPI1上的片选"
        config EPAPER_USE_SS0
            bool "片选0(SS0)"
            select BSP_SPI1_USING_SS0
        config EPAPER_USE_SS1
            bool "片选1(SS1)"
            select BSP_SPI1_USING_SS1
        config EPAPER_USE_SS2
            bool"片选2(SS2)"
            select BSP_SPI1_USING_SS2
        config EPAPER_USE_SS3
            bool"片选3(SS3)"
            select BSP_SPI1_USING_SS3
    endchoice

    menuconfig EPAPER_DC_PIN
        int "墨水屏数据/命令控制引脚"
    default 11
    menuconfig EPAPER_DC_GPIO
        int "墨水屏数据/命令控制GPIO"
    default 1

    menuconfig EPAPER_RST_PIN
        int "墨水屏复位引脚"
    default 12
    menuconfig EPAPER_RST_GPIO
        int "墨水屏复位GPIO"
    default 2

    menuconfig EPAPER_BUSY_PIN
        int "墨水屏BUSY引脚“
        default 13
    menuconfig EPAPER_BUSY_GPIO
        int "墨水屏BUSY GPIO"
        default 3

endif
endmenu

config BSP_USING_UART_HS
    bool "Enable High Speed UART"
    default y

config BSP_USING_UART1
    bool "Enable UART1 (GPIO0/1)"
    default n

config BSP_USING_UART2
    bool "Enable UART2 (GPIO0/1)"
    default n

config BSP_USING_UART3
    bool "Enable UART3 (GPIO0/1)"
    default n

menuconfig BSP_USING_I2C
    bool "Enable I2C"
    select RT_USING_I2C
    default n
if BSP_USING_I2C
    menuconfig BSP_USING_I2C0
        bool "Enable I2C0"
        select RT_USING_I2C0
        default n
    if BSP_USING_I2C0
        config BSP_I2C0_CLK_PIN
            int "i2c0 clk pin number"
            default 0
        config BSP_I2C0_SDA_PIN
            int "i2c0 sda pin number"
            default 1
        config I2C0_SLAVE_ADDR
            hex "i2c0 slave address"
            default 0x00
        config I2C0_ADDR_WIDTH
            int "i2c0 device register width(7 or 10)"
            default 7
        config I2C0_CLK_FREQ
            int "i2c0 clock rate(HZ)"
            default 200000
    endif
    menuconfig BSP_USING_I2C1
        bool "Enable I2C1"
        select RT_USING_I2C1
        default n
    if BSP_USING_I2C1
        config BSP_I2C1_CLK_PIN
            int "i2c1 clk pin number"
            default 2
        config BSP_I2C1_SDA_PIN
            int "i2c1 sda pin number"
            default 3
        config I2C1_SLAVE_ADDR
            hex "i2c1 slave address"
            default 0x00
        config I2C1_ADDR_WIDTH
            int "i2c1 device register width(7 or 10)"
            default 7
        config I2C1_CLK_FREQ
            int "i2c1 clock rate(HZ)"
            default 200000
    endif
    menuconfig BSP_USING_I2C2
        bool "Enable I2C2"
        select RT_USING_I2C2
        default n
    if BSP_USING_I2C2
        config BSP_I2C2_CLK_PIN
            int "i2c2 clk pin number"
            default 4
        config BSP_I2C2_SDA_PIN
            int "i2c2 sda pin number"
            default 5
        config I2C2_SLAVE_ADDR
            hex "i2c2 slave address"
            default 0x00
        config I2C2_ADDR_WIDTH
            int "i2c2 device register width(7 or 10)"
            default 7
        config I2C2_CLK_FREQ
            int "i2c2 clock rate(HZ)"
            default 200000
    endif
endif

menuconfig BSP_USING_SPI1
    bool "Enable SPI1"
    select RT_USING_SPI
    default n
if BSP_USING_SPI1
    config BSP_USING_SPI1_AS_QSPI
        bool
        default n
    config BSP_SPI1_CLK_PIN
        int "spi1 clk pin number"
        default 29
    config BSP_SPI1_D0_PIN
        int "spi1 d0 pin number"
        default 30
    config BSP_SPI1_D1_PIN
        int "spi1 d1 pin number"
        default 31
    if BSP_USING_SPI1_AS_QSPI
        config BSP_SPI1_D2_PIN
            int "spi1 d2 pin number"
            default 32
        config BSP_SPI1_D3_PIN
            int "spi1 d3 pin number"
            default 33
    endif
    menuconfig BSP_SPI1_USING_SS0
        bool "SPI1 Enable SS0"
        default n
    if BSP_SPI1_USING_SS0
        config BSP_SPI1_SS0_PIN
            int "spi1 ss0 pin number"
            default 32
    endif
    menuconfig BSP_SPI1_USING_SS1
        bool "SPI1 Enable SS1"
        default n
    if BSP_SPI1_USING_SS1
        config BSP_SPI1_SS1_PIN
            int "spi1 ss1 pin number"
            default 25
    endif
    menuconfig BSP_SPI1_USING_SS2
        bool "SPI1 Enable SS2"
        default n
    if BSP_SPI1_USING_SS2
        config BSP_SPI1_SS2_PIN
            int "spi1 ss2 pin number"
            default 26
    endif
    menuconfig BSP_SPI1_USING_SS3
        bool "SPI1 Enable SS3"
        default n
    if BSP_SPI1_USING_SS3
        config BSP_SPI1_SS3_PIN
            int "spi1 ss3 pin number"
            default 27
    endif
endif

menuconfig BSP_USING_LCD
    bool "Enable LCD on SPI0"
    default n

if BSP_USING_LCD
    config BSP_LCD_CS_PIN
        int "CS pin number of 8080 interface"
        default 6
    config BSP_LCD_WR_PIN
        int "WR pin number of 8080 interface"
        default 7
    config BSP_LCD_DC_PIN
        int "DC pin number of 8080 interface"
        default 8
    config BSP_LCD_DC_GPIO
        int "DC gpio number of 8080 interface"
        default 0
    config BSP_LCD_X_MAX
        int "LCD Height"
        default 240
    config BSP_LCD_Y_MAX
        int "LCD Width"
        default 320
endif


menuconfig BSP_USING_CAMERA
    bool "Enable Camera"
    default n

if BSP_USING_CAMERA
    config BSP_CAMERA_SCCB_SDA_PIN
        int "SCCB SDA pin number for camera"
        default 9
    config BSP_CAMERA_SCCB_SCLK_PIN
        int "SCCB SCLK pin number for camera"
        default 10
    config BSP_CAMERA_CMOS_RST_PIN
        int "CMOS RST pin number for camera"
        default 11
    config BSP_CAMERA_CMOS_VSYNC_PIN
        int "CMOS VSYNC pin number for camera"
        default 12
    config BSP_CAMERA_CMOS_PWDN_PIN
        int "CMOS PWDN pin number for camera"
        default 13
    config BSP_CAMERA_CMOS_XCLK_PIN
        int "CMOS XCLK pin number for camera"
        default 14
    config BSP_CAMERA_CMOS_PCLK_PIN
        int "CMOS PCLK pin number for camera"
        default 15
    config BSP_CAMERA_CMOS_HREF_PIN
        int "CMOS HREF pin number for camera"
        default 17
endif
```
